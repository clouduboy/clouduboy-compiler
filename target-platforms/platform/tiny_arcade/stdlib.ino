////////////// TINY ARCADE LIB, BASED ON ARDUBOY //////////////////
uint8_t frameRate;
uint16_t frameCount;
uint8_t eachFrameMillis;
long lastFrameStart;
long nextFrameStart;
bool post_render;
uint8_t lastFrameDurationMs;

// Background color
uint16_t _microcanvas_bgcolor = 0x0000;


// Font support
const uint8_t _microcanvas_font_w = 5, _microcanvas_font_h = 7;
int _microcanvas_print_x = 0, _microcanvas_print_y = 0;

// standard ascii 5x7 font
const static unsigned char _microcanvas_font[] PROGMEM =
{
    0x00, 0x00, 0x00, 0x00, 0x00,
    0x3E, 0x5B, 0x4F, 0x5B, 0x3E,
    0x3E, 0x6B, 0x4F, 0x6B, 0x3E,
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    0x00, 0x00, 0x00, 0x00, 0x00,
};


/* Graphics */
void tiny_arcade_clear() {
  tiny_arcade_fillScreen(_microcanvas_bgcolor);
}

void tiny_arcade_fillScreen(uint16_t color) {
  for (int i = 0; i < WIDTH*HEIGHT*BIT_DEPTH; i+=BIT_DEPTH) {
    if (BIT_DEPTH>1) buffer[i] = color >> 8 & 0xff;
    buffer[i+1] = color & 0xff;
  }
}

void tiny_arcade_display() {
  // debug
  tiny_arcade_debug_int(frameCount);

  // write double-buffer contents
  _display.goTo(0, 0);
  _display.startData();
  _display.writeBuffer(buffer, WIDTH * HEIGHT * 2);
  _display.endTransfer();
}

//void tiny_arcade_drawBitmap(int16_t x, int16_t y, const uint8_t *gfx, uint8_t w, uint8_t h, uint8_t blending) {
void tiny_arcade_drawBitmap(int16_t dx, int16_t dy, const uint16_t *gfx, uint8_t w, uint8_t h, uint8_t blending) {
  for (int y = dy; y < min(HEIGHT, dy+h); y++) {
    for (int x = dx; x < min(WIDTH, dx+w); x++) {
      uint16_t color = *gfx++;

      if (x<0 || y<0) continue;

      // Color mode 0 (default)
      // Paint only opaque pixels, skip transparent pixels
      // TODO: transparency handling
      if (blending == WHITE) {
        buffer[(x + y*WIDTH) * BIT_DEPTH] = color >> 8;
        if (BIT_DEPTH == 2) buffer[(x + y*WIDTH) * BIT_DEPTH + 1] = color;
      }
    }
  }
}


/* Frame management */
void tiny_arcade_setFrameRate(uint8_t rate)
{
  frameRate = rate;
  eachFrameMillis = 1000/rate;
}

bool tiny_arcade_everyXFrames(uint8_t frames)
{
  return frameCount % frames == 0;
}

void tiny_arcade_init() {
    // frame management
    tiny_arcade_setFrameRate(60);
    frameCount = 0;
    nextFrameStart = 0;
}

bool tiny_arcade_nextFrame()
{
  long now = millis();
  uint8_t remaining;

  // post render
  if (post_render) {
    lastFrameDurationMs = now - lastFrameStart;
    frameCount++;
    post_render = false;
  }

  // if it's not time for the next frame yet
  if (now < nextFrameStart) {
    remaining = nextFrameStart - now;
    // if we have more than 1ms to spare, lets sleep
    // we should be woken up by timer0 every 1ms, so this should be ok
    if (remaining > 1)
      ///*TODO:where is this from?*/idle();
    ///idle is from Arduboy core.cpp
    ///https://forum.arduino.cc/index.php?topic=337289.msg2325280#msg2325280
    ///
    {
      delay(1);
    }
    return false;
  }

  // pre-render

  // technically next frame should be last frame + each frame but if we're
  // running a slow render we would constnatly be behind the clock
  // keep an eye on this and see how it works.  If it works well the
  // lastFrameStart variable could be eliminated completely
  nextFrameStart = now + eachFrameMillis;
  lastFrameStart = now;
  post_render = true;
  return post_render;
}

bool tiny_arcade_pressed(int btn) {
  switch (btn) {
    case A_BUTTON:
      return checkButton(TAButton1);
    case LEFT_BUTTON:
      return checkJoystick(TAJoystickLeft);
    case RIGHT_BUTTON:
      return checkJoystick(TAJoystickRight);
  }
  return false;
}


void tiny_arcade_setCursor( int x, int y ) {
  _microcanvas_print_x = x;
  _microcanvas_print_y = y;
}
void tiny_arcade_print(const char* string) {
  while (*string > 0 && _microcanvas_print_x < WIDTH-_microcanvas_font_w) {
    tiny_arcade_drawCharacter(_microcanvas_print_x, _microcanvas_print_y, *string, 0xffff, WHITE);
    ++string;
    _microcanvas_print_x+=_microcanvas_font_w+1;
  }
}

//void tiny_arcade_drawBitmap(int16_t x, int16_t y, const uint8_t *gfx, uint8_t w, uint8_t h, uint8_t blending) {
void tiny_arcade_drawCharacter(uint8_t dx, uint8_t dy, char c, int16_t color, uint8_t blending) {
  for (int y = dy; y < min(HEIGHT, dy+_microcanvas_font_h); y++) {
    for (int x = dx; x < min(WIDTH, dx+_microcanvas_font_w); x++) {
      char b = _microcanvas_font[c*5+x-dx];

      if (x<0 || y<0) continue;

      // draw only if appropriate bit is set
      if (b >> (y-dy) & 1) {
        if (blending == WHITE) {
          buffer[(x + y*WIDTH) * BIT_DEPTH] = color >> 8;
          if (BIT_DEPTH == 2) buffer[(x + y*WIDTH) * BIT_DEPTH + 1] = color;
        }
      }
    }
  }
}

void tiny_arcade_fillRect(int dx, int dy, int w, int h, int color) {
  for (int y = dy; y < min(HEIGHT, dy+h); y++) {
    for (int x = dx; x < min(WIDTH, dx+w); x++) {
      if (x<0 || y<0) continue;

      buffer[(x + y*WIDTH) * BIT_DEPTH] = color >> 8;
      if (BIT_DEPTH == 2) buffer[(x + y*WIDTH) * BIT_DEPTH + 1] = color;
    }
  }
}





/// DUMMY / UNIMPLEMENTED

void tiny_arcade_setTextSize(int size) {}



// DEBUG
const uint16_t gfx_numbers[] = {
  /*5x5x12@16b*/ 0x0000, 0x0000, 0x0000, 0x0000, 0x0000, 0x0000, 0xffff, 0xffff, 0xffff, 0x0000, 0x0000, 0xffff, 0x0000, 0xffff, 0x0000, 0x0000, 0xffff, 0x0000, 0xffff, 0x0000, 0x0000, 0xffff, 0xffff, 0xffff, 0x0000, 0x0000, 0x0000, 0x0000, 0x0000, 0x0000, 0x0000, 0x0000, 0xffff, 0x0000, 0x0000, 0x0000, 0x0000, 0xffff, 0x0000, 0x0000, 0x0000, 0x0000, 0xffff, 0x0000, 0x0000, 0x0000, 0x0000, 0xffff, 0x0000, 0x0000, 0x0000, 0x0000, 0x0000, 0x0000, 0x0000, 0x0000, 0xffff, 0xffff, 0xffff, 0x0000, 0x0000, 0x0000, 0x0000, 0xffff, 0x0000, 0x0000, 0xffff, 0xffff, 0x0000, 0x0000, 0x0000, 0xffff, 0xffff, 0xffff, 0x0000, 0x0000, 0x0000, 0x0000, 0x0000, 0x0000, 0x0000, 0xffff, 0xffff, 0xffff, 0x0000, 0x0000, 0x0000, 0x0000, 0xffff, 0x0000, 0x0000, 0x0000, 0xffff, 0xffff, 0x0000, 0x0000, 0xffff, 0xffff, 0xffff, 0x0000, 0x0000, 0x0000, 0x0000, 0x0000, 0x0000, 0x0000, 0xffff, 0x0000, 0x0000, 0x0000, 0x0000, 0xffff, 0x0000, 0xffff, 0x0000, 0x0000, 0xffff, 0xffff, 0xffff, 0x0000, 0x0000, 0x0000, 0x0000, 0xffff, 0x0000, 0x0000, 0x0000, 0x0000, 0x0000, 0x0000, 0x0000, 0xffff, 0xffff, 0xffff, 0x0000, 0x0000, 0xffff, 0x0000, 0x0000, 0x0000, 0x0000, 0x0000, 0xffff, 0xffff, 0x0000, 0x0000, 0xffff, 0xffff, 0xffff, 0x0000, 0x0000, 0x0000, 0x0000, 0x0000, 0x0000, 0x0000, 0xffff, 0x0000, 0x0000, 0x0000, 0x0000, 0xffff, 0x0000, 0x0000, 0x0000, 0x0000, 0xffff, 0xffff, 0xffff, 0x0000, 0x0000, 0xffff, 0xffff, 0xffff, 0x0000, 0x0000, 0x0000, 0x0000, 0x0000, 0x0000, 0x0000, 0xffff, 0xffff, 0xffff, 0x0000, 0x0000, 0x0000, 0x0000, 0xffff, 0x0000, 0x0000, 0x0000, 0x0000, 0xffff, 0x0000, 0x0000, 0x0000, 0x0000, 0xffff, 0x0000, 0x0000, 0x0000, 0x0000, 0x0000, 0x0000, 0x0000, 0xffff, 0xffff, 0xffff, 0x0000, 0x0000, 0xffff, 0x0000, 0xffff, 0x0000, 0x0000, 0xffff, 0xffff, 0xffff, 0x0000, 0x0000, 0xffff, 0xffff, 0xffff, 0x0000, 0x0000, 0x0000, 0x0000, 0x0000, 0x0000, 0x0000, 0xffff, 0xffff, 0xffff, 0x0000, 0x0000, 0xffff, 0x0000, 0xffff, 0x0000, 0x0000, 0xffff, 0xffff, 0xffff, 0x0000, 0x0000, 0x0000, 0x0000, 0xffff, 0x0000, 0x0000, 0x0000, 0x0000, 0x0000, 0x0000, 0x0000, 0x0000, 0x0000, 0x0000, 0x0000, 0x0000, 0x0000, 0xffff, 0x0000, 0x0000, 0x0000, 0x0000, 0x0000, 0x0000, 0x0000, 0x0000, 0x0000, 0xffff, 0x0000, 0x0000, 0x0000, 0x0000, 0x0000, 0x0000, 0x0000, 0x0000, 0x0000, 0x0000, 0x0000, 0x0000, 0x0000, 0x0000, 0x0000, 0x0000, 0x0000, 0x0000, 0x0000, 0x0000, 0x0000, 0x0000, 0x0000, 0x0000, 0x0000, 0x0000, 0x0000
};
void tiny_arcade_debug_int(int var) {
  int pos = 1;
  while (pos < 16 && var > 0) {
    tiny_arcade_drawBitmap(WIDTH-pos*5,0, gfx_numbers+25*(var%10), 5,5,WHITE);
    var /= 10;
    ++pos;
  }
}
